## prj.conf
```kconfig
CONFIG_GPIO=y

CONFIG_GPIO_EMUL=y
```

## app.overlay
```dts
/ {
    aliases {
        sw0 = &button0;
    };

    buttons {

        compatible = "gpio-keys";

        button0: button {
            gpios = <&gpio0 1 GPIO_ACTIVE_HIGH>;
            label = "Button";
        };

    };
};
```

## src/main.c
```c
/*******************************************************************
 * @file main.c
 *
 * @brief Main file.
 * @author João Matheus Nascimento Dias (jmnd@ic.ufal.br)
 * @author José Félix de Oliveira Neto (jfon@ic.ufal.br)
 * @author Matheus Melo dos Santos (mms6@ic.ufal.br)
 * @version 0.1
 * @date 26/08/2026
 *******************************************************************/

#include <zephyr/kernel.h>

#include "board_io.h"
#include <zephyr/drivers/gpio.h>
#include <zephyr/drivers/gpio/gpio_emul.h>

static const struct gpio_dt_spec button = GPIO_DT_SPEC_GET(DT_ALIAS(sw0), gpios);
static const struct gpio_dt_spec led = GPIO_DT_SPEC_GET(DT_ALIAS(led0), gpios);

int main(void)
{
	/* TODO (Atividade-03): chamar io_init() e, pra cada valor da sequência
	 * 0, 1, 0, 1: simular o botão e imprimir "Button: X -> LED: X".
	 */

	const int sequence[] = {0, 1, 0, 1};
	int ret = io_init();

	if (ret < 0) {
		return ret;
	}

	for (int i = 0; i < 4; i++) {

		ret = gpio_emul_input_set(button.port, button.pin, sequence[i]);

		if (ret < 0) {
			return -1;
		}

		const int button_value = button_read();

		if (button_value < 0) {
			return -1;
		}

		const int led_state = led_set(button_value);

		if (led_state < 0) {
			return -1;
		}

		const int led_value = gpio_emul_output_get(led.port, led.pin);

		if (led_value < 0) {
			return -1;
		}

		printk("Button: %d -> LED: %d\n", button_value, led_value);
	}

	return 0;
}
```

## src/board_io.c
```c
#include "board_io.h"

#include <errno.h>
#include <zephyr/device.h>
#include <zephyr/drivers/gpio.h>
#include <zephyr/kernel.h>

static const struct gpio_dt_spec led = GPIO_DT_SPEC_GET(DT_ALIAS(led0), gpios);

static const struct gpio_dt_spec button = GPIO_DT_SPEC_GET(DT_ALIAS(sw0), gpios);

int io_init(void)
{
	int ret;

	if (!gpio_is_ready_dt(&led)) {
		return -ENODEV;
	}

	if (!gpio_is_ready_dt(&button)) {
		return -ENODEV;
	}

	ret = gpio_pin_configure_dt(&led, GPIO_OUTPUT_INACTIVE);
	if (ret < 0) {
		return ret;
	}

	ret = gpio_pin_configure_dt(&button, GPIO_INPUT);
	if (ret < 0) {
		return ret;
	}

	return 0;
}

/* Escreve o nível lógico do LED (ativo em alto). Retorna 0 ou errno negativo. */
int led_set(bool on)
{
	return gpio_pin_set_dt(&led, on);
}

/* Lê o botão: 1 pressionado, 0 solto, ou errno negativo. */
int button_read(void)
{
	return gpio_pin_get_dt(&button);
}
```
